## firmware/main/Kconfig.projbuild
```kconfig
menu "M5 TimerCam Configuration"

    config M5CAM_WIFI_SSID
        string "WiFi SSID"
        default ""
        help
            Your home WiFi network name.

    config M5CAM_WIFI_PASSWORD
        string "WiFi Password"
        default ""
        help
            Your home WiFi password.

    config M5CAM_SERVER_IP
        string "Server IP"
        default "192.168.1.100"
        help
            IP address of the machine running the FastAPI server.

    config M5CAM_SERVER_PORT
        int "Server Port"
        default 8000
        help
            Port of the FastAPI server.

    config M5CAM_CAPTURE_INTERVAL_MINUTES
        int "Capture interval (minutes)"
        default 5
        range 1 1440
        help
            How often to wake from deep sleep and capture a frame.

    config M5CAM_TEST_MODE
        bool "Enable test mode (no deep sleep)"
        default n
        help
            In test mode the device captures every 2 seconds without
            entering deep sleep. Useful for initial setup and pipeline testing.

endmenu
```

## firmware/sdkconfig.defaults
```kconfig
# Default sdkconfig for M5 Timer Camera X
# Copy to sdkconfig, then run: idf.py menuconfig
# and fill in WIFI_SSID, WIFI_PASSWORD, SERVER_IP

# Flash & RAM
CONFIG_ESPTOOLPY_FLASHSIZE_4MB=y
CONFIG_PARTITION_TABLE_CUSTOM=y
CONFIG_PARTITION_TABLE_CUSTOM_FILENAME="partitions.csv"
CONFIG_SPIRAM_SUPPORT=y
CONFIG_ESP32_SPIRAM_SUPPORT=y
CONFIG_SPIRAM_USE_MALLOC=y
CONFIG_SPIRAM_MALLOC_ALWAYSINTERNAL=16384

# Camera framebuffer in PSRAM
CONFIG_CAMERA_TASK_STACK_SIZE=4096

# FreeRTOS tick rate
CONFIG_FREERTOS_HZ=1000

# WiFi
CONFIG_ESP_WIFI_STATIC_RX_BUFFER_NUM=10
CONFIG_ESP_WIFI_DYNAMIC_RX_BUFFER_NUM=32

# HTTP server
CONFIG_HTTPD_MAX_REQ_HDR_LEN=1024

# Application defaults (override in menuconfig)
CONFIG_M5CAM_SERVER_PORT=8000
CONFIG_M5CAM_CAPTURE_INTERVAL_MINUTES=5
CONFIG_M5CAM_TEST_MODE=y
```
